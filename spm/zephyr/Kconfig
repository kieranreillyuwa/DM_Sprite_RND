## spm/zephyr/Kconfig
```kconfig
#
# Copyright (c) 2019 Nordic Semiconductor ASA
#
# SPDX-License-Identifier: LicenseRef-BSD-5-Clause-Nordic
#

menu "DM_SPM"

menuconfig IS_DM_SPM
	bool "Current app is SPM"
	default n
	select TRUSTED_EXECUTION_SECURE
#         select ARM_FIRMWARE_HAS_SECURE_ENTRY_FUNCS
#         select NORDIC_SECURITY_BACKEND 
#         select ENTROPY_CC3XX

# if ARM_FIRMWARE_USES_SECURE_ENTRY_FUNCS
# config ARM_ENTRY_VENEERS_LIB_NAME
# 	string "Entry Veneers symbol file"
# 	default "spm/libspmsecureentries.a"
# endif

# if ARM_FIRMWARE_HAS_SECURE_ENTRY_FUNCS
# config ARM_ENTRY_VENEERS_LIB_NAME
# 	string "Entry Veneers symbol file"
# 	default "libspmsecureentries.a"
# endif

endmenu # SPM
```
