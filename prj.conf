## CMakeLists.txt
```
# SPDX-License-Identifier: Apache-2.0

cmake_minimum_required(VERSION 3.20.0)

list(APPEND ZEPHYR_EXTRA_MODULES ${CMAKE_CURRENT_SOURCE_DIR}/boot)
list(APPEND ZEPHYR_EXTRA_MODULES ${CMAKE_CURRENT_SOURCE_DIR}/spm)
find_package(Zephyr REQUIRED HINTS $ENV{ZEPHYR_BASE})
project(hello_world)

target_sources(app PRIVATE src/main.c)
```

## Kconfig
```
#
# Copyright (c) 2019 Nordic Semiconductor ASA
#
# SPDX-License-Identifier: LicenseRef-BSD-5-Clause-Nordic
#

menu "DM Config"

config DM_SPM
	bool "Use Secure Partition Manager"
	default y if TRUSTED_EXECUTION_NONSECURE
	# imply ARM_FIRMWARE_USES_SECURE_ENTRY_FUNCS
config TEST_BOOT
	bool "test bl"
	default y if TRUSTED_EXECUTION_NONSECURE

if DM_SPM
module=DM_SPM
source "${ZEPHYR_BASE}/../nrf/subsys/partition_manager/Kconfig.template.build_strategy"
endif

config FW_INFO_MAGIC_LEN
	int
	default 12
	help
	  Annoyingly this needs to be set to compile

endmenu # DM config

menu "Zephyr Kernel"
source "Kconfig.zephyr"
endmenu
```

## prj.conf
```kconfig
# nothing here
CONFIG_NRF_MODEM_LIB_ON_FAULT_APPLICATION_SPECIFIC=y
CONFIG_NET_NATIVE=n
CONFIG_NRF_MODEM_LIB=y
CONFIG_POSIX_MAX_FDS=8
CONFIG_NRF_MODEM_LIB_SYS_INIT=n
CONFIG_NETWORKING=y
CONFIG_NET_SOCKETS_OFFLOAD=y
CONFIG_NET_SOCKETS=y
CONFIG_NET_SOCKETS_POSIX_NAMES=y
CONFIG_NET_SOCKETS_SOCKOPT_TLS=n


CONFIG_NRF_MODEM_LIB_HEAP_SIZE=4096
CONFIG_NRF_MODEM_LIB_SHMEM_TX_SIZE=32768
CONFIG_HEAP_MEM_POOL_SIZE=4096
CONFIG_MAIN_STACK_SIZE=4096
CONFIG_IDLE_STACK_SIZE=2048
CONFIG_SYSTEM_WORKQUEUE_STACK_SIZE=3072
CONFIG_HW_STACK_PROTECTION=y
# CONFIG_NRF_MODEM_LIB_TRACE=y

CONFIG_ARM_MPU=n

CONFIG_HAVE_CUSTOM_LINKER_SCRIPT=y
CONFIG_CUSTOM_LINKER_SCRIPT="linker.ld"

CONFIG_BUILD_WITH_TFM=n
CONFIG_SPM=n

CONFIG_DM_SPM=y
CONFIG_TEST_BOOT=y
CONFIG_SPM_SECURE_SERVICES=n

CONFIG_SRAM_BASE_ADDRESS=0x20000000
CONFIG_SRAM_SIZE=190
CONFIG_NO_OPTIMIZATIONS=y

# CONFIG_NRF_MODEM_LIB_IPC_IRQ_PRIO_OVERRIDE=y
# # CONFIG_MODEM_KEY_MGMT=y
# # CONFIG_MODEM_ANTENNA_AT_MAGPIO="AT%XMAGPIO=1,0,0,1,1,1574,1577"
# # CONFIG_MODEM_ANTENNA_AT_COEX0="AT%XCOEX0=1,1,1565,1586"
# CONFIG_NEWLIB_LIBC_MIN_REQUIRED_HEAP_SIZE=2048
```

## src/main.c
```c
/*
 * Copyright (c) 2012-2014 Wind River Systems, Inc.
 *
 * SPDX-License-Identifier: Apache-2.0
 */

#include <zephyr/kernel.h>
#include <modem/nrf_modem_lib.h>
#include <nrf_modem_at.h>
#include <zephyr/sys/reboot.h>
#include <string.h>


#ifndef __NOP
#define __NOP(x) arch_nop()
#endif 

void nrf_modem_fault_handler(struct nrf_modem_fault_info *fault_info)
{
    __NOP();
    // LOG_INF("Modem fault! Reason: 0x%08X    PC: 0x%08X", pFaultInfo->reason, pFaultInfo->program_counter);
	printk("modem fault!!\r\n");
    k_busy_wait(10000000);
}


	
void main(void)
{
	printk("entering!\r\n");

	int32_t iResponse = INT32_MIN;
	iResponse = nrf_modem_lib_init(NORMAL_MODE);

	printk("iResp = %d\r\n", iResponse);

	uint8_t abResp[100];
    memset(abResp, 0, 100 * sizeof(char));
	
	abResp[0] = 0x0A;



	const char *atCmd = "AT+CGMI";

	iResponse = nrf_modem_at_cmd(abResp, 100 * sizeof(uint8_t), atCmd);

	printk("iRespAtCmd = %d\r\n", iResponse);



	for(;;)
	{
		__NOP();
	}
}
```
